# file: ADC_01.ioc
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Mcu.Family=STM32F4
Mcu.Name=STM32F411V(C-E)Tx
Mcu.Package=LQFP100
NVIC.PriorityGroup=NVIC_PRIORITYGROUP_0
PH0\ -\ OSC_IN.Mode=HSE-External-Oscillator
PH0\ -\ OSC_IN.Signal=RCC_OSC_IN
PH1\ -\ OSC_OUT.Mode=HSE-External-Oscillator
PH1\ -\ OSC_OUT.Signal=RCC_OSC_OUT
ProjectManager.HeapSize=0x200
ProjectManager.StackSize=0x400
ProjectManager.TargetToolchain=STM32CubeIDE
RCC.48MHZClocksFreq_Value=48000000
RCC.AHBFreq_Value=96000000
RCC.APB1CLKDivider=RCC_HCLK_DIV4
RCC.APB1Freq_Value=24000000
RCC.APB1TimFreq_Value=48000000
RCC.APB2Freq_Value=96000000
RCC.APB2TimFreq_Value=96000000
RCC.CortexFreq_Value=96000000
RCC.HCLKFreq_Value=96000000
RCC.HSE_VALUE=8000000
RCC.HSI_VALUE=16000000
RCC.LSE_VALUE=32768
RCC.PLLI2SM=5
RCC.PLLI2SN=200
RCC.PLLM=4
RCC.PLLP=RCC_PLLP_DIV4
RCC.PLLQ=8
RCC.PLLSourceVirtual=RCC_PLLSOURCE_HSE
RCC.SYSCLKFreq_VALUE=96000000
RCC.SYSCLKSource=RCC_SYSCLKSOURCE_PLLCLK
RCC.VCOOutputFreq_Value=384000000
board=STM32F411E-DISCO

// file: Core/Src/main.c
/* USER CODE BEGIN Header */
/**
  ******************************************************************************
  * @file           : main.c
  * @brief          : Main program body
  ******************************************************************************
  * @attention
  *
  * Copyright (c) 2024 STMicroelectronics.
  * All rights reserved.
  *
  * This software is licensed under terms that can be found in the LICENSE file
  * in the root directory of this software component.
  * If no LICENSE file comes with this software, it is provided AS-IS.
  *
  ******************************************************************************
  */
/* USER CODE END Header */
#include "main.h"

/* USER CODE BEGIN PD */
void Led_On(void);
/* USER CODE END PD */

/* USER CODE BEGIN PV */

//uint8_t adc_value=0;
//uint8_t value=0;

uint16_t adc_value=0;
uint16_t value=0;

/* USER CODE END PV */

void SystemClock_Config(void);
static void MX_GPIO_Init(void);

/* USER CODE BEGIN 0 */

void GPIO_Config()
{
	RCC->AHB1ENR |=RCC_AHB1ENR_GPIOAEN;

	GPIOA->MODER |=GPIO_MODER_MODE0_0;
	GPIOA->MODER |=GPIO_MODER_MODE0_1;
}

void ADC_Init()
{
	RCC->APB2ENR |=RCC_APB2ENR_ADC1EN;

	//ADC1->CR1 &=~(ADC_CR1_RES_0); // Resolution 8 bit
	//ADC1->CR1 |=ADC_CR1_RES_1;

	ADC1->CR1 &=~(ADC_CR1_RES_0); // Resolution 12 bit
	ADC1->CR1 &=~(ADC_CR1_RES_1);

	ADC1->CR2 |=ADC_CR2_ADON;  // ADC1 enable
	ADC1->CR2 |=ADC_CR2_CONT;  // Continuous conversion mode
	//ADC1->CR2 &=~(ADC_CR2_CONT);  // Single conversion mode

	ADC1->SMPR2 |=ADC_SMPR2_SMP0_0;  // 56 cycles
	ADC1->SMPR2 |=ADC_SMPR2_SMP0_1;
	ADC1->SMPR2 &=~(ADC_SMPR2_SMP0_2);

	ADC->CCR |=ADC_CCR_ADCPRE_0;
	ADC->CCR &=~(ADC_CCR_ADCPRE_1);

	ADC1->HTR |=(1<<0);
	ADC1->HTR |=(1<<1);

}

uint8_t Read_ADC(){

ADC1->CR2 |=ADC_CR2_SWSTART;
while(!(ADC1->SR & ADC_SR_EOC));
//Led_On();
value=ADC1->DR;
return value;
}

void Led_Init()
{
	RCC->AHB1ENR |=RCC_AHB1ENR_GPIODEN;
	GPIOD->MODER |=GPIO_MODER_MODE15_0;
	GPIOD->MODER &=~(GPIO_MODER_MODE15_1);
	GPIOD->OTYPER &=~(GPIO_OTYPER_OT15);
	GPIOD->OSPEEDR &=~(GPIO_OSPEEDER_OSPEEDR15_0);
	GPIOD->OSPEEDR &=~(GPIO_OSPEEDER_OSPEEDR15_1);
	GPIOD->PUPDR &=~(GPIO_PUPDR_PUPD15_0);
	GPIOD->PUPDR &=~(GPIO_PUPDR_PUPD15_1);
}

void Led_On()
{
	GPIOD->ODR |=GPIO_ODR_OD15;
}

void Led_Off()
{
	GPIOD->ODR &=~(GPIO_ODR_OD15);

}

void time1()
{
	for (int var = 0; var < 10000000; ++var) {

	}
}

/* USER CODE END 0 */

int main(void)
{

  /* MCU Configuration--------------------------------------------------------*/

  /* Reset of all peripherals, Initializes the Flash interface and the Systick. */
  HAL_Init();

  /* USER CODE BEGIN Init */

  Led_Init();
  ADC_Init();
  GPIO_Config();

  /* USER CODE END Init */

  /* Configure the system clock */
  SystemClock_Config();

  /* Initialize all configured peripherals */
  MX_GPIO_Init();
  /* USER CODE BEGIN 2 */

  /* 4- Enable Interrupt enable for EOC*/
   //SET_BIT(USART2->CR1, USART_CR1_RXNEIE);
  	 ADC1->CR1 |=ADC_CR1_EOCIE;

   /* 5 - Enable ADC Interrupt in NVIC */

	HAL_NVIC_SetPriority(ADC_IRQn, 1, 1);
	HAL_NVIC_EnableIRQ(ADC_IRQn);

  /* USER CODE END 2 */

  /* Infinite loop */
  /* USER CODE BEGIN WHILE */
  while (1)
  {
	  adc_value = Read_ADC();
	  time1();
	 /* if(ADC1->SR |=ADC_SR_EOC)
	  {
		  AdcVerisi = ADC1->DR;
		  time1();
	  }*/
	 // while(ADC1->SR & ADC_SR_EOC)
	 // {	  Led_On();	  }
	 // time1();
	 // Led_Off();
	 // time1();
    /* USER CODE END WHILE */

  }
}

void SystemClock_Config(void)
{
  RCC_OscInitTypeDef RCC_OscInitStruct = {0};
  RCC_ClkInitTypeDef RCC_ClkInitStruct = {0};

  /** Configure the main internal regulator output voltage
  */
  __HAL_RCC_PWR_CLK_ENABLE();
  __HAL_PWR_VOLTAGESCALING_CONFIG(PWR_REGULATOR_VOLTAGE_SCALE1);

  /** Initializes the RCC Oscillators according to the specified parameters
  * in the RCC_OscInitTypeDef structure.
  */
  RCC_OscInitStruct.OscillatorType = RCC_OSCILLATORTYPE_HSE;
  RCC_OscInitStruct.HSEState = RCC_HSE_ON;
  RCC_OscInitStruct.PLL.PLLState = RCC_PLL_ON;
  RCC_OscInitStruct.PLL.PLLSource = RCC_PLLSOURCE_HSE;
  RCC_OscInitStruct.PLL.PLLM = 4;
  RCC_OscInitStruct.PLL.PLLN = 192;
  RCC_OscInitStruct.PLL.PLLP = RCC_PLLP_DIV4;
  RCC_OscInitStruct.PLL.PLLQ = 8;
  if (HAL_RCC_OscConfig(&RCC_OscInitStruct) != HAL_OK)
  {
    Error_Handler();
  }

  /** Initializes the CPU, AHB and APB buses clocks
  */
  RCC_ClkInitStruct.ClockType = RCC_CLOCKTYPE_HCLK|RCC_CLOCKTYPE_SYSCLK
                              |RCC_CLOCKTYPE_PCLK1|RCC_CLOCKTYPE_PCLK2;
  RCC_ClkInitStruct.SYSCLKSource = RCC_SYSCLKSOURCE_PLLCLK;
  RCC_ClkInitStruct.AHBCLKDivider = RCC_SYSCLK_DIV1;
  RCC_ClkInitStruct.APB1CLKDivider = RCC_HCLK_DIV4;
  RCC_ClkInitStruct.APB2CLKDivider = RCC_HCLK_DIV1;

  if (HAL_RCC_ClockConfig(&RCC_ClkInitStruct, FLASH_LATENCY_3) != HAL_OK)
  {
    Error_Handler();
  }
}

static void MX_GPIO_Init(void)
{

  /* GPIO Ports Clock Enable */
  __HAL_RCC_GPIOH_CLK_ENABLE();

}

/* USER CODE BEGIN 4 */

void ADC_IRQHandler()
{
	if(ADC1->DR >= ADC1->HTR)
	{
	Led_On();
	}
}

/* USER CODE END 4 */

void Error_Handler(void)
{
  __disable_irq();
  while (1)
  {
  }
}
